## package/libudev/Config.in
```kconfig
config BR2_PACKAGE_LIBUDEV
	bool
	depends on BR2_USE_MMU # eudev / systemd
	depends on BR2_USE_WCHAR # eudev / systemd
	depends on !BR2_STATIC_LIBS # eudev / systemd
	select BR2_PACKAGE_EUDEV if !BR2_PACKAGE_SYSTEMD

config BR2_PACKAGE_HAS_LIBUDEV
	bool

config BR2_PACKAGE_PROVIDES_LIBUDEV
	string
	depends on BR2_PACKAGE_HAS_LIBUDEV
```

## package/monero/Config.in
```kconfig
config BR2_PACKAGE_MONERO
	bool "monero"
	depends on !BR2_aarch64_be && !BR2_i386
	depends on BR2_INSTALL_LIBSTDCPP
	depends on !BR2_STATIC_LIBS
	depends on BR2_TOOLCHAIN_HAS_THREADS
	depends on BR2_TOOLCHAIN_SUPPORTS_ALWAYS_LOCKFREE_ATOMIC_INTS # boost-filesystem
	# monero needs fenv.h which is not provided by uclibc
	depends on !BR2_TOOLCHAIN_USES_UCLIBC
	select BR2_PACKAGE_BOOST
	select BR2_PACKAGE_BOOST_CHRONO
	select BR2_PACKAGE_BOOST_DATE_TIME
	select BR2_PACKAGE_BOOST_FILESYSTEM
	select BR2_PACKAGE_BOOST_LOCALE
	select BR2_PACKAGE_BOOST_PROGRAM_OPTIONS
	select BR2_PACKAGE_BOOST_REGEX
	select BR2_PACKAGE_BOOST_SERIALIZATION
	select BR2_PACKAGE_BOOST_SYSTEM
	select BR2_PACKAGE_BOOST_THREAD
	select BR2_PACKAGE_CZMQ
	select BR2_PACKAGE_LIBMINIUPNPC
	select BR2_PACKAGE_LIBSODIUM
	select BR2_PACKAGE_OPENSSL
	select BR2_PACKAGE_UNBOUND
	help
	  The secure, private, untraceable cryptocurrency

	  https://getmonero.org/

comment "monero needs a glibc or musl toolchain w/ C++, dynamic library, threads"
	depends on !BR2_aarch64_be && !BR2_i386
	depends on BR2_TOOLCHAIN_SUPPORTS_ALWAYS_LOCKFREE_ATOMIC_INTS
	depends on BR2_TOOLCHAIN_USES_UCLIBC || \
		!BR2_INSTALL_LIBSTDCPP || BR2_STATIC_LIBS || \
		!BR2_TOOLCHAIN_HAS_THREADS
```

## package/openjdk-bootstrap/Config.in.host
```kconfig
config BR2_PACKAGE_HOST_OPENJDK_BOOTSTRAP
	bool "host openjdk bootstrap"
	depends on BR2_HOSTARCH = "x86_64" || BR2_HOSTARCH = "x86"
	help
	  OpenJDK (Open Java Development Kit) is a free and open source
	  implementation of the Java Platform, Standard Edition
	  This package provides a binary installation of the JDK created
	  by the BLFS editors.

	  http://openjdk.java.net
	  http://www.linuxfromscratch.org/blfs/view/svn/general/java.html
```

## package/openrgb/Config.in
```kconfig
config BR2_PACKAGE_OPENRGB
	bool "openrgb"
	depends on BR2_INSTALL_LIBSTDCPP
	depends on BR2_TOOLCHAIN_HAS_THREADS_NPTL # hidapi
	depends on BR2_TOOLCHAIN_GCC_AT_LEAST_4_9 # libusb -> hidapi
	depends on BR2_PACKAGE_HAS_UDEV # hidapi
	depends on BR2_PACKAGE_QT5
	select BR2_PACKAGE_HIDAPI
	select BR2_PACKAGE_QT5BASE_GUI
	select BR2_PACKAGE_QT5BASE_WIDGETS
	help
	  Open source RGB lighting control that doesn't depend on
	  manufacturer software.

	  https://openrgb.org/

comment "openrgb needs Qt5, udev /dev management and a toolchain w/ C++, NPTL, threads, gcc >= 4.9"
	depends on !BR2_PACKAGE_QT5 || \
		!BR2_INSTALL_LIBSTDCPP || \
		!BR2_TOOLCHAIN_HAS_THREADS_NPTL || \
		!BR2_PACKAGE_HAS_UDEV || \
		!BR2_TOOLCHAIN_GCC_AT_LEAST_4_9
```

## package/p2pool/Config.in
```kconfig
config BR2_PACKAGE_P2POOL
	bool "p2pool"
	depends on BR2_ARCH_IS_64
	depends on !BR2_aarch64_be
	depends on BR2_INSTALL_LIBSTDCPP
	depends on !BR2_STATIC_LIBS # libuv
	depends on BR2_TOOLCHAIN_HAS_SYNC_4 # libuv
	depends on BR2_TOOLCHAIN_HAS_THREADS_NPTL # libuv
	# p2pool needs fenv.h which is not provided by uclibc
	depends on !BR2_TOOLCHAIN_USES_UCLIBC
	depends on BR2_USE_MMU # libuv
	select BR2_PACKAGE_LIBCURL
	select BR2_PACKAGE_LIBUV
	select BR2_PACKAGE_ZEROMQ
	help
	  Decentralized pool for Monero mining

	  https://p2pool.io/

comment "monero needs a glibc or musl toolchain w/ C++, NPTL, dynamic library"
	depends on BR2_ARCH_IS_64
	depends on !BR2_aarch64_be
	depends on BR2_TOOLCHAIN_HAS_SYNC_4
	depends on BR2_USE_MMU
	depends on !BR2_TOOLCHAIN_HAS_THREADS_NPTL || \
		BR2_STATIC_LIBS || !BR2_INSTALL_LIBSTDCPP || \
		BR2_TOOLCHAIN_USES_UCLIBC
```

## package/perl-mail-spamassassin/Config.in
```kconfig
config BR2_PACKAGE_PERL_MAIL_SPAMASSASSIN
	bool "perl-mail-spamassassin"
	depends on !BR2_STATIC_LIBS
	select BR2_PACKAGE_PERL_DIGEST_SHA1 # runtime
	select BR2_PACKAGE_PERL_HTML_PARSER # runtime
	select BR2_PACKAGE_PERL_MAIL_DKIM # runtime
	select BR2_PACKAGE_PERL_NET_DNS # runtime
	select BR2_PACKAGE_PERL_NETADDR_IP # runtime
	help
	  SpamAssassin is an extensible email filter which is used to
	  identify spam

	  https://spamassassin.apache.org

comment "perl-mail-spamassassin needs a toolchain w/ dynamic library"
	depends on BR2_STATIC_LIBS

if BR2_PACKAGE_PERL_MAIL_SPAMASSASSIN

config BR2_PACKAGE_PERL_MAIL_SPAMASSASSIN_CONTACT_ADDRESS
	string "contact address"
	default "the administrator of that BR system"
	help
	  What email address or URL should be used in the suspected-spam
	  report text for users who want more information on your filter
	  installation?

endif
```

## package/pppd/Config.in
```kconfig
config BR2_PACKAGE_PPPD
	bool "pppd"
	depends on !BR2_sparc64 && !BR2_sparc
	depends on !BR2_STATIC_LIBS
	depends on BR2_USE_MMU
	select BR2_PACKAGE_OPENSSL if BR2_TOOLCHAIN_USES_GLIBC
	select BR2_PACKAGE_LIBOPENSSL_ENABLE_DES if BR2_PACKAGE_LIBOPENSSL
	help
	  An implementation of the Point-to-point protocol.

	  http://www.samba.org/ppp/

if BR2_PACKAGE_PPPD

config BR2_PACKAGE_PPPD_FILTER
	bool "filtering"
	select BR2_PACKAGE_LIBPCAP
	help
	  Packet filtering abilities for pppd. If enabled,
	  the pppd active-filter and pass-filter options
	  are available.

endif

comment "pppd needs a toolchain w/ dynamic library"
	depends on !BR2_sparc64 && !BR2_sparc
	depends on BR2_STATIC_LIBS
	depends on BR2_USE_MMU

# pppd is disabled for sparc and sparc64 architectures because it fails
# to build with a redefinition of 'struct termio' error, with no proper
# fix or workaround for now
comment "pppd is disabled for sparc and sparc64 architectures"
	depends on BR2_sparc64 || BR2_sparc
```

## package/python-backports-shutil-which/Config.in
```kconfig
config BR2_PACKAGE_PYTHON_BACKPORTS_SHUTIL_WHICH
	bool "python-backports-shutil-which"
	depends on BR2_PACKAGE_PYTHON
	help
	  Backport of shutil.which from Python 3.3

	  https://pypi.python.org/pypi/backports.shutil_which
```

## package/python-iso-639/Config.in
```kconfig
config BR2_PACKAGE_PYTHON_ISO_639
	bool "python-iso-639"
	help
	  Python library for ISO 639 standard.

	  https://github.com/noumar/iso639
```

## package/python-iso3166/Config.in
```kconfig
config BR2_PACKAGE_PYTHON_ISO3166
	bool "python-iso3166"
	help
	  Self-contained ISO 3166-1 country definitions.

	  http://github.com/deactivated/python-iso3166
```

## package/python-pycryptodome/Config.in
```kconfig
config BR2_PACKAGE_PYTHON_PYCRYPTODOME
	bool "python-pycryptodome"
	help
	  Cryptographic library for Python.

	  http://www.pycryptodome.org
```

## package/python-streamlink/Config.in
```kconfig
config BR2_PACKAGE_PYTHON_STREAMLINK
	bool "python-streamlink"
	select BR2_PACKAGE_PYTHON_FUTURES # runtime
	select BR2_PACKAGE_PYTHON_SINGLEDISPATCH # runtime
	select BR2_PACKAGE_PYTHON_REQUESTS # runtime
	select BR2_PACKAGE_PYTHON_PYCRYPTODOME # runtime
	select BR2_PACKAGE_PYTHON_BACKPORTS_SHUTIL_WHICH # runtime
	select BR2_PACKAGE_PYTHON_BACKPORTS_SHUTIL_GET_TERMINAL_SIZE # runtime
	select BR2_PACKAGE_PYTHON_ISO_639 # runtime
	select BR2_PACKAGE_PYTHON_ISO3166 # runtime
	help
	  Streamlink is command-line utility that extracts streams from
	  various services and pipes them into a video player of choice.

	  https://github.com/streamlink/streamlink
```

## package/spidermonkey185/Config.in
```kconfig
config BR2_PACKAGE_SPIDERMONKEY185
	bool "spidermonkey (1.8.5)"
	depends on BR2_USE_MMU # fork in executable tools.
	depends on BR2_INSTALL_LIBSTDCPP
	depends on !BR2_STATIC_LIBS
	depends on BR2_TOOLCHAIN_HAS_THREADS_NPTL # needs pthread_getattr_np()
	help
	  SpiderMonkey is Mozilla's JavaScript engine written in C/C++. It is
	  used in various Mozilla products, including Firefox.

	  This is the old 1.8.5 branch, used in Firefox 4.

comment "Spider monkey (1.8.5) need a toolchain with C++, dynamic library, NPTL"
	depends on BR2_USE_MMU
	depends on !BR2_INSTALL_LIBSTDCPP || BR2_STATIC_LIBS || \
		!BR2_TOOLCHAIN_HAS_THREADS_NPTL
```

## package/usbutils/Config.in
```kconfig
config BR2_PACKAGE_USBUTILS
	bool "usbutils"
	depends on BR2_TOOLCHAIN_HAS_THREADS # libusb
	depends on BR2_TOOLCHAIN_GCC_AT_LEAST_4_9 # libusb
	depends on BR2_USE_MMU # libudev <- eudev/systemd
	depends on BR2_USE_WCHAR # libudev <- eudev/systemd
	depends on !BR2_STATIC_LIBS # libudev <- eudev/systemd
	select BR2_PACKAGE_EUDEV_ENABLE_HWDB if BR2_PACKAGE_EUDEV
	select BR2_PACKAGE_SYSTEMD_HWDB if BR2_PACKAGE_SYSTEMD
	select BR2_PACKAGE_LIBUDEV
	select BR2_PACKAGE_LIBUSB
	help
	  USB enumeration utilities

	  http://linux-usb.sourceforge.net/

comment "usbutils needs a toolchain w/ threads, wchar, dynamic library, gcc >= 4.9"
	depends on BR2_USE_MMU
	depends on !BR2_TOOLCHAIN_HAS_THREADS || \
		!BR2_USE_WCHAR || BR2_STATIC_LIBS || \
		!BR2_TOOLCHAIN_GCC_AT_LEAST_4_9
```

## package/utfcpp/Config.in
```kconfig
config BR2_PACKAGE_UTFCPP
	bool "utfcpp"
	help
	  UTF-8 with C++ in a Portable Way

	  https://github.com/nemtrif/utfcpp
```

## package/vdr-plugin-wirbelscan/Config.in
```kconfig
config BR2_PACKAGE_VDR_PLUGIN_WIRBELSCAN
	bool "vdr-plugin-wirbelscan"
	depends on BR2_PACKAGE_VDR
	depends on BR2_TOOLCHAIN_HEADERS_AT_LEAST_3_7 # w_scan
	select BR2_PACKAGE_W_SCAN
	help
	  This plugin performs a channel scan for digital terrestrial
	  and digital cable TV and analog ivtv cards, satellite is also
	  supported.

	  http://wirbel.htpc-forum.de/wirbelscan/index2.html

comment "vdr-plugin-wirbelscan needs a toolchain w/ headers >= 3.7"
	depends on !BR2_TOOLCHAIN_HEADERS_AT_LEAST_3_7
```

## package/vdr-plugin-wirbelscancontrol/Config.in
```kconfig
config BR2_PACKAGE_VDR_PLUGIN_WIRBELSCANCONTROL
	bool "vdr-plugin-wirbelscancontrol"
	depends on BR2_PACKAGE_VDR_PLUGIN_WIRBELSCAN
	help
	  This plugin extends the wirbelscan plugin with a main menu
	  entry. It may serve also as an example how to control the
	  wirbelscan plugin via it's service interface.

	  http://wirbel.htpc-forum.de/wirbelscancontrol/index2.html
```
