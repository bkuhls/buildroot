## package/fontconfig/Config.in
```kconfig
config BR2_PACKAGE_FONTCONFIG
	bool "fontconfig"
	depends on BR2_USE_WCHAR
	depends on BR2_ENABLE_LOCALE # locale_t
	select BR2_PACKAGE_FREETYPE
	select BR2_PACKAGE_EXPAT
	help
	  Fontconfig is a library for configuring and customizing font
	  access.

	  http://www.fontconfig.org/

comment "fontconfig needs a toolchain w/ wchar, locale"
	depends on !BR2_USE_WCHAR || !BR2_ENABLE_LOCALE
```

## package/ghostscript/Config.in
```kconfig
config BR2_PACKAGE_GHOSTSCRIPT
	bool "ghostscript"
	depends on BR2_USE_MMU # fork()
	depends on BR2_ENABLE_LOCALE # fontconfig
	select BR2_PACKAGE_FONTCONFIG
	select BR2_PACKAGE_GHOSTSCRIPT_FONTS
	select BR2_PACKAGE_JPEG
	select BR2_PACKAGE_LCMS2
	select BR2_PACKAGE_LIBPNG
	select BR2_PACKAGE_TIFF
	help
	  Ghostscript is an interpreter for PostScript and Portable
	  Document Format (PDF) files.

	  http://ghostscript.com

comment "ghostscript needs a toolchain w/ locale"
	depends on !BR2_ENABLE_LOCALE
```

## package/mesa-libclc/Config.in
```kconfig
config BR2_PACKAGE_MESA_LIBCLC
	bool "mesa-libclc"
	depends on BR2_PACKAGE_LLVM
	select BR2_PACKAGE_LLVM_AMDGPU
	select BR2_PACKAGE_LLVM_RTTI
	help
	  This is a fork of LLVM's libclc applying some fixes of a
	  known good state to be used by Mesa3D.

	  https://gitlab.freedesktop.org/karolherbst/mesa-libclc

comment "mesa-libclc needs llvm"
	depends on !BR2_PACKAGE_LLVM
```

## package/mupdf/Config.in
```kconfig
config BR2_PACKAGE_MUPDF
	bool "mupdf"
	depends on BR2_INSTALL_LIBSTDCPP # harfbuzz
	depends on BR2_TOOLCHAIN_HAS_SYNC_4 # harfbuzz
	depends on BR2_TOOLCHAIN_GCC_AT_LEAST_4_9 # harfbuzz
	select BR2_PACKAGE_FREETYPE
	select BR2_PACKAGE_GUMBO_PARSER
	select BR2_PACKAGE_HARFBUZZ
	select BR2_PACKAGE_JBIG2DEC
	select BR2_PACKAGE_JPEG
	select BR2_PACKAGE_LCMS2
	select BR2_PACKAGE_OPENJPEG
	select BR2_PACKAGE_ZLIB
	help
	  MuPDF is a lightweight PDF, XPS, and E-book viewer.

	  https://www.mupdf.com/

comment "mupdf needs a toolchain w/ C++, gcc >= 4.9"
	depends on BR2_TOOLCHAIN_HAS_SYNC_4
	depends on !BR2_INSTALL_LIBSTDCPP || \
		!BR2_TOOLCHAIN_GCC_AT_LEAST_4_9

if BR2_PACKAGE_MUPDF
config BR2_PACKAGE_MUPDF_PYTHON_BINDINGS
	bool "python bindings for mupdf"
	depends on !BR2_STATIC_LIBS
	depends on BR2_PACKAGE_PYTHON3
	select BR2_PACKAGE_HOST_SWIG
endif
```

## package/python-pipcl/Config.in
```kconfig
config BR2_PACKAGE_PYTHON_PIPCL
	bool "python-pipcl"
	help
	  Python packaging operations, including PEP-517 support, for
	  use by a setup.py script.

	  https://github.com/ArtifexSoftware/pipcl
```

## package/python-pycairo/Config.in
```kconfig
config BR2_PACKAGE_PYTHON_PYCAIRO
	bool "python-pycairo"
	depends on BR2_ENABLE_LOCALE # cairo -> fontconfig
	select BR2_PACKAGE_CAIRO
	help
	  Python interface for cairo.

	  https://pycairo.readthedocs.io

comment "python-pycairo needs a toolchain w/ locale"
	depends on !BR2_ENABLE_LOCALE
```

## package/resiprocate/Config.in
```kconfig
comment "resiprocate needs a toolchain w/ C++, threads, wchar"
	depends on BR2_USE_MMU
	depends on !BR2_INSTALL_LIBSTDCPP || !BR2_TOOLCHAIN_HAS_THREADS || !BR2_USE_WCHAR

config BR2_PACKAGE_RESIPROCATE
	bool "resiprocate"
	depends on BR2_INSTALL_LIBSTDCPP
	depends on BR2_TOOLCHAIN_HAS_THREADS
	depends on BR2_USE_WCHAR
	depends on BR2_USE_MMU # fork()
	select BR2_PACKAGE_C_ARES
	select BR2_PACKAGE_LIBOPENSSL_ENABLE_DES if BR2_PACKAGE_LIBOPENSSL
	help
	  reSIProcate is a framework that aims to fully implement the
	  SIP protocol in first class C++. It is intended for use in
	  other applications, such as the repro SIP proxy.

	  By default this package provides the core libraries: librutil
	  (utilities), libresip (SIP stack/RFC compliant message
	  parsing) and libdum (SIP Dialog Usage Manager, a state
	  machine for SIP dialogs).

	  https://github.com/resiprocate/resiprocate

if BR2_PACKAGE_RESIPROCATE

config BR2_PACKAGE_RESIPROCATE_DTLS_SUPPORT
	bool "DTLS support"
	select BR2_PACKAGE_OPENSSL
	help
	  Enable DTLS support (requires OpenSSL)

config BR2_PACKAGE_RESIPROCATE_REND
	bool "resiprocate-rend"
	depends on BR2_TOOLCHAIN_GCC_AT_LEAST_4_8 # boost-system
	select BR2_PACKAGE_BOOST
	select BR2_PACKAGE_BOOST_SYSTEM
	select BR2_PACKAGE_OPENSSL
	select BR2_PACKAGE_POPT
	help
	  Rend is tool that is was created specifically to load test
	  gtSIP based presence servers.

comment "resiprocate-rend needs a toolchain w/ C++11, gcc>=4.8"
	depends on !BR2_TOOLCHAIN_GCC_AT_LEAST_4_8

endif # BR2_PACKAGE_RESIPROCATE
```

## package/x11r7/xapp_x11perf/Config.in
```kconfig
config BR2_PACKAGE_XAPP_X11PERF
	bool "x11perf"
	depends on BR2_ENABLE_LOCALE # fontconfig
	select BR2_PACKAGE_XLIB_LIBX11
	select BR2_PACKAGE_XLIB_LIBXMU
	select BR2_PACKAGE_XLIB_LIBXFT
	help
	  summarize x11perf results

comment "x11perf needs a toolchain w/ locale"
	depends on !BR2_ENABLE_LOCALE
```

## package/x11r7/xapp_xfd/Config.in
```kconfig
config BR2_PACKAGE_XAPP_XFD
	bool "xfd"
	depends on BR2_ENABLE_LOCALE # fontconfig
	select BR2_PACKAGE_FREETYPE
	select BR2_PACKAGE_FONTCONFIG
	select BR2_PACKAGE_XLIB_LIBXAW
	select BR2_PACKAGE_XLIB_LIBXFT
	help
	  X.Org xfd application

comment "xfd needs a toolchain w/ locale"
	depends on !BR2_ENABLE_LOCALE
```

## package/x11r7/xapp_xlogo/Config.in
```kconfig
config BR2_PACKAGE_XAPP_XLOGO
	bool "xlogo"
	depends on BR2_ENABLE_LOCALE # fontconfig
	select BR2_PACKAGE_XLIB_LIBXAW
	select BR2_PACKAGE_XLIB_LIBXRENDER
	select BR2_PACKAGE_XLIB_LIBXFT
	help
	  X Window System logo

comment "xlogo needs a toolchain w/ locale"
	depends on !BR2_ENABLE_LOCALE
```

## package/x11r7/xlib_libXft/Config.in
```kconfig
config BR2_PACKAGE_XLIB_LIBXFT
	bool "libXft"
	depends on BR2_ENABLE_LOCALE # fontconfig
	select BR2_PACKAGE_FONTCONFIG
	select BR2_PACKAGE_FREETYPE
	select BR2_PACKAGE_XLIB_LIBX11
	select BR2_PACKAGE_XLIB_LIBXEXT
	select BR2_PACKAGE_XLIB_LIBXRENDER
	select BR2_PACKAGE_XORGPROTO
	help
	  X.Org Xft library

comment "libXft needs a toolchain w/ locale"
	depends on !BR2_ENABLE_LOCALE
```

## support/testing/tests/package/br2-external/boost/Config.in
```kconfig
source "$BR2_EXTERNAL_BOOST_RUNTIME_TEST_PATH/package/boost-runtime-test/Config.in"
```

## support/testing/tests/package/br2-external/boost/package/boost-runtime-test/Config.in
```kconfig
config BR2_PACKAGE_BOOST_RUNTIME_TEST
	bool "boost-runtime-test"
	depends on BR2_PACKAGE_BOOST
	help
	  Test programs for the Boost libraries. A test program is
	  built for each enabled Boost library.
```
