## configs/fli4l_defconfig
```kconfig
BR2_x86_64=y
BR2_x86_westmere=y
BR2_TOOLCHAIN_EXTERNAL=y
BR2_PACKAGE_HOST_GDB=y
BR2_GDB_VERSION_16=y
BR2_CCACHE=y
BR2_CCACHE_DIR="/media/ccache"
BR2_CCACHE_INITIAL_SETUP="--max-size=200G"
# BR2_CCACHE_USE_BASEDIR is not set
BR2_GLOBAL_PATCH_DIR="board/fli4l/patches"
BR2_PER_PACKAGE_DIRECTORIES=y
BR2_ROOTFS_DEVICE_CREATION_STATIC=y
BR2_ENABLE_LOCALE_WHITELIST="C en_US de_DE"
BR2_GENERATE_LOCALE="C.UTF-8 en_US de_DE"
BR2_SYSTEM_ENABLE_NLS=y
BR2_TARGET_TZ_INFO=y
BR2_TARGET_LOCALTIME="Europe/Berlin"
BR2_ROOTFS_OVERLAY="board/fli4l/rootfs_overlay"
BR2_ROOTFS_POST_BUILD_SCRIPT="board/fli4l/post_build.sh"
BR2_LINUX_KERNEL=y
BR2_LINUX_KERNEL_CUSTOM_VERSION=y
BR2_LINUX_KERNEL_CUSTOM_VERSION_VALUE="6.18.39"
BR2_LINUX_KERNEL_USE_CUSTOM_CONFIG=y
BR2_LINUX_KERNEL_CUSTOM_CONFIG_FILE="board/fli4l/linux-config-x86_64"
BR2_LINUX_KERNEL_INSTALL_TARGET=y
BR2_LINUX_KERNEL_NEEDS_HOST_LIBELF=y
BR2_PACKAGE_BUSYBOX_CONFIG="board/fli4l/busybox.config"
BR2_PACKAGE_BUSYBOX_SHOW_OTHERS=y
BR2_PACKAGE_BZIP2=y
BR2_PACKAGE_PIGZ=y
BR2_PACKAGE_XZ=y
BR2_PACKAGE_ZSTD=y
BR2_PACKAGE_GDB=y
BR2_PACKAGE_GDB_DEBUGGER=y
BR2_PACKAGE_STRACE=y
BR2_PACKAGE_VALGRIND=y
BR2_PACKAGE_GETTEXT=y
BR2_PACKAGE_GREP=y
BR2_PACKAGE_DOSFSTOOLS=y
BR2_PACKAGE_DOSFSTOOLS_FSCK_FAT=y
BR2_PACKAGE_DOSFSTOOLS_MKFS_FAT=y
BR2_PACKAGE_E2FSPROGS=y
BR2_PACKAGE_MTOOLS=y
BR2_PACKAGE_XKEYBOARD_CONFIG=y
BR2_PACKAGE_LINUX_FIRMWARE=y
BR2_PACKAGE_LINUX_FIRMWARE_I915=y
BR2_PACKAGE_LINUX_FIRMWARE_MEDIATEK_MT7922=y
BR2_PACKAGE_LINUX_FIRMWARE_RTL_8169=y
BR2_PACKAGE_LINUX_FIRMWARE_CX23885=y
BR2_PACKAGE_ACPID=y
BR2_PACKAGE_DMIDECODE=y
BR2_PACKAGE_GPTFDISK=y
BR2_PACKAGE_GPTFDISK_GDISK=y
BR2_PACKAGE_GPTFDISK_SGDISK=y
BR2_PACKAGE_HWDATA=y
BR2_PACKAGE_HWDATA_PNP_IDS=y
BR2_PACKAGE_HWLOC=y
BR2_PACKAGE_I2C_TOOLS=y
BR2_PACKAGE_IUCODE_TOOL=y
BR2_PACKAGE_KBD=y
BR2_PACKAGE_MSR_TOOLS=y
BR2_PACKAGE_RNG_TOOLS=y
BR2_PACKAGE_SMARTMONTOOLS=y
BR2_PACKAGE_USB_MODESWITCH_DATA=y
BR2_PACKAGE_USBUTILS=y
BR2_PACKAGE_TCL=y
BR2_PACKAGE_LIBZIP=y
BR2_PACKAGE_CA_CERTIFICATES=y
BR2_PACKAGE_GNUTLS=y
BR2_PACKAGE_LIBOPENSSL_BIN=y
BR2_PACKAGE_LIBOPENSSL_ENGINES=y
BR2_PACKAGE_SQLITE=y
BR2_PACKAGE_LIBQRENCODE=y
BR2_PACKAGE_LIBQRENCODE_TOOLS=y
BR2_PACKAGE_LIBCURL=y
BR2_PACKAGE_LIBCURL_CURL=y
BR2_PACKAGE_LIBOPING=y
BR2_PACKAGE_LIBTIRPC_RPCDB=y
BR2_PACKAGE_ELFUTILS=y
BR2_PACKAGE_UTFCPP=y
BR2_PACKAGE_HAVEGED=y
BR2_PACKAGE_BYTES2READ=y
BR2_PACKAGE_CRON=y
BR2_PACKAGE_DECODE_CHUNKED=y
BR2_PACKAGE_HCONV=y
BR2_PACKAGE_IMOND=y
BR2_PACKAGE_IMOND_STAT=y
BR2_PACKAGE_LOCKCOMMAND=y
BR2_PACKAGE_MINI_HTTPD=y
BR2_PACKAGE_MINI_LOGIN=y
BR2_PACKAGE_NETCALC_FLI4L=y
BR2_PACKAGE_PROCCGI=y
BR2_PACKAGE_OVPNCTRL=y
BR2_PACKAGE_BIND=y
BR2_PACKAGE_BIND_TOOLS=y
BR2_PACKAGE_BRIDGE_UTILS=y
BR2_PACKAGE_CHRONY=y
BR2_PACKAGE_CONNTRACK_TOOLS=y
BR2_PACKAGE_CRDA=y
BR2_PACKAGE_DHCP=y
BR2_PACKAGE_DHCP_SERVER=y
BR2_PACKAGE_DHCP_RELAY=y
BR2_PACKAGE_DHCP_CLIENT=y
BR2_PACKAGE_DHCPCD=y
BR2_PACKAGE_DNSMASQ=y
BR2_PACKAGE_DNSMASQ_CONNTRACK=y
BR2_PACKAGE_DROPBEAR=y
BR2_PACKAGE_DROPBEAR_DISABLE_REVERSEDNS=y
BR2_PACKAGE_DROPBEAR_LOCALOPTIONS_FILE="board/fli4l/dropbear_localoptions.h"
BR2_PACKAGE_EBTABLES=y
BR2_PACKAGE_ETHTOOL=y
BR2_PACKAGE_FPING=y
BR2_PACKAGE_HOSTAPD=y
BR2_PACKAGE_HOSTAPD_EAP=y
BR2_PACKAGE_HOSTAPD_WPS=y
BR2_PACKAGE_HOSTAPD_WPA3=y
BR2_PACKAGE_IFTOP=y
BR2_PACKAGE_IFUPDOWN=y
BR2_PACKAGE_IPERF3=y
BR2_PACKAGE_IPROUTE2=y
BR2_PACKAGE_IPSET=y
BR2_PACKAGE_IPTABLES=y
BR2_PACKAGE_IW=y
BR2_PACKAGE_LIGHTTPD=y
BR2_PACKAGE_LIGHTTPD_OPENSSL=y
BR2_PACKAGE_LIGHTTPD_PCRE=y
BR2_PACKAGE_MROUTED=y
BR2_PACKAGE_NETCAT_OPENBSD=y
BR2_PACKAGE_NETSNMP=y
BR2_PACKAGE_NGREP=y
BR2_PACKAGE_NTP=y
BR2_PACKAGE_NTP_NTPDC=y
BR2_PACKAGE_NTP_NTPQ=y
BR2_PACKAGE_OPENSSH=y
BR2_PACKAGE_OPENVPN=y
BR2_PACKAGE_PPPD_FILTER=y
BR2_PACKAGE_PURE_FTPD=y
BR2_PACKAGE_PURE_FTPD_FTPWHO=y
BR2_PACKAGE_PUTTY=y
BR2_PACKAGE_RADVD=y
BR2_PACKAGE_RP_PPPOE=y
BR2_PACKAGE_SMCROUTE=y
BR2_PACKAGE_SOCAT=y
BR2_PACKAGE_STUNNEL=y
BR2_PACKAGE_TCPDUMP=y
BR2_PACKAGE_WGET=y
BR2_PACKAGE_WGET2=y
BR2_PACKAGE_WIRELESS_TOOLS=y
BR2_PACKAGE_WIRELESS_TOOLS_LIB=y
BR2_PACKAGE_WPA_SUPPLICANT=y
# BR2_PACKAGE_WPA_SUPPLICANT_NL80211 is not set
BR2_PACKAGE_WPA_SUPPLICANT_EAP=y
BR2_PACKAGE_WPA_SUPPLICANT_WPS=y
BR2_PACKAGE_WPA_SUPPLICANT_CLI=y
BR2_PACKAGE_WPA_SUPPLICANT_PASSPHRASE=y
BR2_PACKAGE_WPA_SUPPLICANT_DBUS=y
BR2_PACKAGE_APG=y
BR2_PACKAGE_GNUPG2=y
BR2_PACKAGE_SCREEN=y
BR2_PACKAGE_SUDO=y
BR2_PACKAGE_COREUTILS=y
BR2_PACKAGE_COREUTILS_INDIVIDUAL_BINARIES=y
BR2_PACKAGE_EFIBOOTMGR=y
BR2_PACKAGE_KMOD=y
BR2_PACKAGE_PROCPS_NG=y
BR2_PACKAGE_SYSVINIT=y
BR2_PACKAGE_TAR=y
BR2_PACKAGE_UTIL_LINUX_BINARIES=y
BR2_PACKAGE_UTIL_LINUX_SCHEDUTILS=y
BR2_PACKAGE_E3=y
BR2_PACKAGE_MC=y
# BR2_TARGET_ROOTFS_TAR is not set
BR2_TARGET_SYSLINUX=y
BR2_TARGET_SYSLINUX_ISOLINUX=y
BR2_TARGET_SYSLINUX_PXELINUX=y
BR2_TARGET_SYSLINUX_MBR=y
BR2_TARGET_SYSLINUX_EFI=y
```

## package/couchdb/Config.in
```kconfig
comment "CouchDB needs a toolchain with C++, wchar, NPTL, dynamic libs, gcc >= 4.9, host gcc >= 4.9"
	depends on !BR2_BINFMT_FLAT
	depends on BR2_USE_MMU
	depends on !BR2_PACKAGE_ERLANG_ARCH_SUPPORTS
	depends on !BR2_PACKAGE_LIBNSPR_ARCH_SUPPORT
	depends on !BR2_TOOLCHAIN_HAS_THREADS_NPTL || \
		BR2_STATIC_LIBS || !BR2_INSTALL_LIBSTDCPP || \
		!BR2_USE_WCHAR || \
		!BR2_TOOLCHAIN_GCC_AT_LEAST_4_9 || \
		!BR2_HOST_GCC_AT_LEAST_4_9

config BR2_PACKAGE_COUCHDB
	bool "couchdb"
	depends on !BR2_BINFMT_FLAT # icu
	depends on BR2_HOST_GCC_AT_LEAST_4_9 # icu
	depends on BR2_INSTALL_LIBSTDCPP # icu, spidermonkey185
	depends on BR2_PACKAGE_ERLANG_ARCH_SUPPORTS
	depends on BR2_PACKAGE_LIBNSPR_ARCH_SUPPORT # spidermonkey185
	depends on !BR2_STATIC_LIBS # erlang
	depends on BR2_TOOLCHAIN_HAS_THREADS_NPTL # spidermonkey185
	depends on BR2_TOOLCHAIN_GCC_AT_LEAST_4_9 # icu
	depends on BR2_USE_MMU # erlang, spidermonkey185
	depends on BR2_USE_WCHAR # icu
	select BR2_PACKAGE_ERLANG
	select BR2_PACKAGE_ICU
	select BR2_PACKAGE_LIBCURL
	select BR2_PACKAGE_LIBXCRYPT if BR2_TOOLCHAIN_USES_GLIBC
	select BR2_PACKAGE_OPENSSL
	select BR2_PACKAGE_SPIDERMONKEY185
	help
	  Apache CouchDB database

	  https://couchdb.apache.org/
```

## package/e3/Config.in
```kconfig
config BR2_PACKAGE_E3
	bool "e3"
	depends on BR2_i386 || BR2_x86_64
	help
	  e3 is a full-screen, user-friendly text editor with an
	  interface similar to that of either WordStar, Emacs, Pico,
	  Nedit, or vi written in NASM assembler.

	  https://sites.google.com/site/e3editor
```

## package/eudev/Config.in
```kconfig
# This symbol is outside the eudev if-block, so that we do not have
# a circular dependency in kconfig. Thus, we need the dummy symbol,
# below, to inform the user that the daemon has indeed been enabled.
config BR2_PACKAGE_EUDEV_DAEMON
	bool
	select BR2_PACKAGE_HAS_UDEV
	select BR2_PACKAGE_UDEV_GENTOO_SCRIPTS if BR2_INIT_OPENRC
	select BR2_PACKAGE_UTIL_LINUX
	select BR2_PACKAGE_UTIL_LINUX_LIBS
	select BR2_PACKAGE_UTIL_LINUX_LIBBLKID
	select BR2_PACKAGE_KMOD
	# We can select this has we're sure eudev is selected when we are.
	select BR2_PACKAGE_EUDEV_DAEMON_DUMMY

config BR2_PACKAGE_EUDEV
	bool "eudev"
	depends on BR2_USE_MMU # uses fork()
	depends on BR2_USE_WCHAR # needs C99 compiler
	depends on !BR2_STATIC_LIBS # kmod
	depends on !BR2_INIT_SYSTEMD
	select BR2_PACKAGE_HAS_LIBUDEV
	help
	  eudev is a fork of systemd-udev with the goal of obtaining
	  better compatibility with existing software such as OpenRC and
	  Upstart, older kernels, various toolchains and anything else
	  required by users and various distributions.

	  https://github.com/eudev-project/eudev

if BR2_PACKAGE_EUDEV

config BR2_PACKAGE_PROVIDES_LIBUDEV
	default "eudev"

config BR2_PACKAGE_EUDEV_DAEMON_DUMMY
	bool "udev daemon"
	depends on BR2_ROOTFS_DEVICE_CREATION_DYNAMIC_EUDEV
	help
	  Install the udev daemon.

# Use the dummy symbol for proper indetation
if BR2_PACKAGE_EUDEV_DAEMON_DUMMY

config BR2_PACKAGE_PROVIDES_UDEV
	default "eudev"

config BR2_PACKAGE_EUDEV_RULES_GEN
	bool "enable rules generator"
	help
	  Enable persistent rules generator

endif # BR2_PACKAGE_EUDEV_DAEMON

config BR2_PACKAGE_EUDEV_ENABLE_HWDB
	bool "enable hwdb installation"
	default y
	select BR2_PACKAGE_HOST_EUDEV # for udevadm, during target-finalize
	help
	  Enables hardware database installation to /etc/udev/hwdb.bin

comment "udev daemon needs eudev /dev management"
	depends on BR2_USE_MMU
	depends on !BR2_ROOTFS_DEVICE_CREATION_DYNAMIC_EUDEV

endif # BR2_PACKAGE_EUDEV

comment "eudev needs a toolchain w/ wchar, dynamic library"
	depends on BR2_USE_MMU
	depends on !BR2_USE_WCHAR || BR2_STATIC_LIBS
	depends on !BR2_INIT_SYSTEMD

comment "eudev is incompatible with systemd init"
	depends on BR2_INIT_SYSTEMD
```

## package/fli4l/bytes2read/Config.in
```kconfig
config BR2_PACKAGE_BYTES2READ
	bool "bytes2read"
	help
	  Fli4l-specific utility: Converts a number of bytes to some other,
	  more readable value, expressed by kiB, MiB, GiB, TiP, PiB, or EiB.
```

## package/fli4l/decode_chunked/Config.in
```kconfig
config BR2_PACKAGE_DECODE_CHUNKED
	bool "decode_chunked"
	help
	  Fli4l-specific utility: Converts chunked HTTP transfers to
	  non-chunked ones.
```

## package/fli4l/dsltool/Config.in
```kconfig
config BR2_PACKAGE_DSLTOOL
	bool "dsltool"
	depends on BR2_INSTALL_LIBSTDCPP # pango
	depends on !BR2_STATIC_LIBS # collectd
	depends on BR2_TOOLCHAIN_GCC_AT_LEAST_4_9 # harfbuzz -> pango
	depends on BR2_TOOLCHAIN_HAS_SYNC_4 # harfbuzz -> pango
	depends on BR2_TOOLCHAIN_HAS_THREADS # collectd, glib2 -> pango
	depends on BR2_USE_WCHAR # glib2 -> pango
	depends on BR2_USE_MMU # collectd, pango
	select BR2_PACKAGE_CAIRO
	select BR2_PACKAGE_CAIRO_PNG
	select BR2_PACKAGE_COLLECTD
	select BR2_PACKAGE_LIBTELNET
	select BR2_PACKAGE_LIBXML2
	select BR2_PACKAGE_PANGO
	select BR2_PACKAGE_ZLIB
	help
	  Tool to monitor DSL modem data

	  https://gitlab.com/dsltool/dsltool
	  https://repo.nettworks.org/svn/fli4l/branches/3.10/testing/src/packages/src/src/fli4l/dsltool/

comment "dsltool needs a toolchain w/ wchar, threads, dynamic library, C++, gcc >= 4.9"
	depends on BR2_USE_MMU
	depends on BR2_TOOLCHAIN_HAS_SYNC_4
	depends on !BR2_USE_WCHAR || !BR2_TOOLCHAIN_HAS_THREADS || \
		!BR2_TOOLCHAIN_GCC_AT_LEAST_4_9 || \
		!BR2_INSTALL_LIBSTDCPP || BR2_STATIC_LIBS
```

## package/fli4l/imond-stat/Config.in
```kconfig
config BR2_PACKAGE_IMOND_STAT
	bool "imond-stat"
	help
	  Fli4l-specific utility: Monitors and controls ISDN and DSL
	  connections.

	  http://www.fli4l.de
```

## package/fli4l/imond/Config.in
```kconfig
config BR2_PACKAGE_IMOND
	bool "imond"
	select BR2_PACKAGE_LIBXCRYPT if BR2_TOOLCHAIN_USES_GLIBC
	help
	  Fli4l-specific utility: Monitors and controls ISDN and DSL
	  connections.

	  http://www.fli4l.de
```

## package/fli4l/lockcommand/Config.in
```kconfig
config BR2_PACKAGE_LOCKCOMMAND
	bool "lockcommand"
	help
	  Fli4l-specific utility: Simple wrapper programm which calls its own
	  command-name with a attached postfix but serialized. Its main purpose
	  is the serialization of iptables commands. As it rewrites its own
	  called name it should be suitable for all other tools, too
```

## package/fli4l/mini-httpd/Config.in
```kconfig
config BR2_PACKAGE_MINI_HTTPD
	bool "mini-httpd"
	select BR2_PACKAGE_LIBXCRYPT if BR2_TOOLCHAIN_USES_GLIBC
	help
	  mini_httpd is a small HTTP server.  Its performance is not great, but
	  for low or medium traffic sites it's quite adequate. It implements
	  all the basic features of an HTTP server. It can also be configured
	  to do SSL/HTTPS.
```

## package/fli4l/mini-login/Config.in
```kconfig
config BR2_PACKAGE_MINI_LOGIN
	bool "mini-login"
	select BR2_PACKAGE_LIBXCRYPT if BR2_TOOLCHAIN_USES_GLIBC
	help
	  Fli4l-specific utility: Minimalistic login program.
```

## package/fli4l/netcalc-fli4l/Config.in
```kconfig
config BR2_PACKAGE_NETCALC_FLI4L
	bool "netcalc-fli4l"
	help
	  Fli4l-specific utility: Performs various calculations on IP addresses.
```

## package/fli4l/ovpnctrl/Config.in
```kconfig
config BR2_PACKAGE_OVPNCTRL
	bool "ovpnctrl"
	help
	  Fli4l-specific utility: ovpnctrl
```

## package/fli4l/proccgi/Config.in
```kconfig
config BR2_PACKAGE_PROCCGI
	bool "proccgi"
	help
	  Reads form variables and dumps them on standard output.
```

## package/igt-gpu-tools/Config.in
```kconfig
config BR2_PACKAGE_IGT_GPU_TOOLS
	bool "igt-gpu-tools"
	depends on BR2_USE_MMU # libglib2, procps-ng
	depends on !BR2_STATIC_LIBS # elfutils, kmod
	depends on BR2_TOOLCHAIN_HAS_THREADS # elfutils, libdrm, libglib2
	depends on BR2_TOOLCHAIN_USES_UCLIBC || BR2_TOOLCHAIN_USES_GLIBC # elfutils
	depends on BR2_USE_WCHAR # elfutils, libglib2
	depends on BR2_PACKAGE_HAS_UDEV
	select BR2_PACKAGE_BUSYBOX_SHOW_OTHERS # procps-ng
	select BR2_PACKAGE_CAIRO
	select BR2_PACKAGE_CAIRO_PNG
	select BR2_PACKAGE_ELFUTILS
	select BR2_PACKAGE_KMOD
	select BR2_PACKAGE_LIBDRM
	select BR2_PACKAGE_LIBGLIB2
	select BR2_PACKAGE_LIBPCIACCESS
	select BR2_PACKAGE_OPENSSL
	select BR2_PACKAGE_PIXMAN
	select BR2_PACKAGE_PROCPS_NG
	select BR2_PACKAGE_ZLIB
	help
	  IGT GPU Tools is a collection of tools for development and
	  testing of the DRM drivers.

	  https://gitlab.freedesktop.org/drm/igt-gpu-tools

comment "igt-gpu-tools needs udev /dev management and a glibc or uclibc toolchain w/ threads, wchar, dynamic library"
	depends on BR2_USE_MMU
	depends on !BR2_PACKAGE_HAS_UDEV || BR2_STATIC_LIBS || \
		!(BR2_TOOLCHAIN_USES_UCLIBC || BR2_TOOLCHAIN_USES_GLIBC) || \
		!BR2_TOOLCHAIN_HAS_THREADS || !BR2_USE_WCHAR
```

## package/kissfft/Config.in
```kconfig
config BR2_PACKAGE_KISSFFT
	bool "kissfft"
	help
	  A Fast Fourier Transform (FFT) library that tries to Keep it
	  Simple, Stupid

	  https://github.com/mborgerding/kissfft
```

## package/kodi-pvr-mediaportal-tvserver/Config.in
```kconfig
config BR2_PACKAGE_KODI_PVR_MEDIAPORTAL_TVSERVER
	bool "kodi-pvr-mediaportal-tvserver"
	depends on !BR2_TOOLCHAIN_USES_MUSL
	select BR2_PACKAGE_TINYXML
	help
	  MediaPortal TVServer PVR client addon for Kodi

	  https://github.com/kodi-pvr/pvr.mediaportal.tvserver

comment "kodi-pvr-mediaportal-tvserver needs a uClibc or glibc toolchain"
	depends on BR2_TOOLCHAIN_USES_MUSL
```

## package/kodi-skin-confluence/Config.in
```kconfig
config BR2_PACKAGE_KODI_SKIN_CONFLUENCE
	bool "kodi-skin-confluence"
	select BR2_PACKAGE_KODI_SKIN_ENABLED
	help
	  Kodi confluence skin

	  https://github.com/xbmc/skin.confluence
```

## package/libinput/Config.in
```kconfig
config BR2_PACKAGE_LIBINPUT
	bool "libinput"
	depends on BR2_USE_MMU # libudev <- eudev/systemd
	depends on BR2_USE_WCHAR # libudev <- eudev/systemd
	depends on !BR2_STATIC_LIBS # libudev <- eudev/systemd
	depends on BR2_ENABLE_LOCALE
	select BR2_PACKAGE_LIBEVDEV
	select BR2_PACKAGE_MTDEV
	select BR2_PACKAGE_LIBUDEV
	help
	  libinput is a library to handle input devices in Wayland
	  compositors and to provide a generic X.Org input driver.
	  It provides device detection, device handling, input device
	  event processing and abstraction so minimize the amount of
	  custom input code compositors need to provide the common
	  set of functionality that users expect.

	  http://freedesktop.org/wiki/Software/libinput/

comment "libinput needs a toolchain w/ locale, wchar, dynamic library"
	depends on BR2_USE_MMU
	depends on !BR2_ENABLE_LOCALE || !BR2_USE_WCHAR || BR2_STATIC_LIBS
```

## package/libplacebo/Config.in
```kconfig
config BR2_PACKAGE_LIBPLACEBO
	bool "libplacebo"
	help

	  https://code.videolan.org/videolan/dav1d
```

## package/libudev-zero/Config.in
```kconfig
config BR2_PACKAGE_LIBUDEV_ZERO
	bool "libudev-zero"
	depends on !BR2_STATIC_LIBS
	depends on BR2_TOOLCHAIN_HAS_THREADS
	select BR2_PACKAGE_HAS_UDEV
	help
	  libudev-zero is a daemonless replacement for libudev

	  https://github.com/illiliti/libudev-zero

comment "libudev-zero needs a toolchain w/ threads, dynamic library"
	depends on !BR2_TOOLCHAIN_HAS_THREADS || \
		BR2_STATIC_LIBS

if BR2_PACKAGE_LIBUDEV_ZERO

config BR2_PACKAGE_PROVIDES_UDEV
	default "libudev-zero"

endif
```
